## esp32/sdkconfig.defaults
```kconfig
CONFIG_IDF_TARGET="esp32"
CONFIG_ESP_MAIN_TASK_STACK_SIZE=8192
CONFIG_SMART_PLANT_SOIL_DRY_RAW=1246
CONFIG_SMART_PLANT_SOIL_WET_RAW=2390
CONFIG_SMART_PLANT_SOIL_CALIBRATED=y
```
